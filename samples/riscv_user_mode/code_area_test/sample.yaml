## samples/riscv_user_mode/code_area_test/sample.yaml
```yaml
sample:
  description: Code Area testing
    application
  name: code area
common:
    tags: introduction
    harness: console
    harness_config:
      type: one_line
      regex:
        - "Hello Code Area! (.*)"
tests:
  sample.helloworld:
    tags: introduction
```

## samples/riscv_user_mode/stack_execution_test/sample.yaml
```yaml
sample:
  description: Stack testing
    application
  name: stack
common:
    tags: introduction
    harness: console
    harness_config:
      type: one_line
      regex:
        - "Hello Stack! (.*)"
tests:
  sample.helloworld:
    tags: introduction
```

## samples/riscv_user_mode/thread_test/sample.yaml
```yaml
sample:
  description: Thread testing
    application
  name: thread
common:
    tags: introduction
    harness: console
    harness_config:
      type: one_line
      regex:
        - "Hello Thread! (.*)"
tests:
  sample.helloworld:
    tags: introduction
```
